## NEMU/configs/m6502-nes-dut_defconfig
```kconfig
CONFIG_ISA_m6502=y
CONFIG_ENGINE_INTERPRETER=y
CONFIG_MODE_SYSTEM=y
CONFIG_TARGET_NATIVE_ELF=y
CONFIG_CC_GCC=y
CONFIG_CC_O2=y
CONFIG_MSIZE=0x10000
CONFIG_MBASE=0x0
CONFIG_PC_RESET_OFFSET=0x8000
CONFIG_PMEM_GARRAY=y
# CONFIG_MEM_RANDOM is not set
CONFIG_TRACE=y
CONFIG_TRACE_START=0
CONFIG_TRACE_END=10000
CONFIG_ITRACE=y
CONFIG_ITRACE_COND="true"
CONFIG_RT_CHECK=y
CONFIG_TIMER_GETTIMEOFDAY=y
CONFIG_NES=y
CONFIG_DIFFTEST=y
CONFIG_DIFFTEST_REF_QEMU=y
```

## NEMU/configs/m6502-nesref-so_defconfig
```kconfig
CONFIG_ISA_m6502=y
CONFIG_ENGINE_INTERPRETER=y
CONFIG_MODE_SYSTEM=y
CONFIG_TARGET_SHARE=y
CONFIG_CC_GCC=y
CONFIG_CC_O2=y
CONFIG_MSIZE=0x10000
CONFIG_MBASE=0x0
CONFIG_PC_RESET_OFFSET=0x8000
CONFIG_PMEM_GARRAY=y
# CONFIG_MEM_RANDOM is not set
# CONFIG_TRACE is not set
# CONFIG_ITRACE is not set
# CONFIG_NES is not set
```
